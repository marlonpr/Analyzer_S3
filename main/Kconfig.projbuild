## main/Kconfig.projbuild
```kconfig
menu "Analyzer v10 configuration"

config ANALYZER_V10_UART_BAUD
    int "Analyzer UART baud rate"
    default 115200
    range 9600 2000000

config ANALYZER_V10_GPIO_ESP01_COMMIT
    int "ESP01 COMMIT analyzer GPIO"
    default 5
    range 0 48

config ANALYZER_V10_GPIO_ESP02_COMMIT
    int "ESP02 COMMIT analyzer GPIO"
    default 15
    range 0 48

config ANALYZER_V10_GPIO_ESP03_COMMIT
    int "ESP03 COMMIT analyzer GPIO"
    default 16
    range 0 48

config ANALYZER_V10_TRAIN_MIN_US
    int "Minimum same-channel 1 Hz interval (us)"
    default 995000
    range 900000 1000000

config ANALYZER_V10_TRAIN_MAX_US
    int "Maximum same-channel 1 Hz interval (us)"
    default 1005000
    range 1000000 1100000

config ANALYZER_V10_ASSOCIATION_WINDOW_US
    int "Cross-device boundary association window (us)"
    default 5000
    range 100 50000

config ANALYZER_V10_NEW_TRAIN_GAP_US
    int "Gap that starts a new countdown train (us)"
    default 1500000
    range 1100000 10000000

config ANALYZER_V10_START_GATED_BOUNDARIES
    int "Number of initial boundaries gated by physical skew"
    default 3
    range 1 20

config ANALYZER_V10_START_TRIPWIRE_US
    int "Start max-min COMMIT tripwire (us)"
    default 100
    range 1 100000

endmenu
```
